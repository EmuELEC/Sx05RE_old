## projects/S905/devices/K1Plus/dvb_tv/Kconfig
```kconfig
#
# AVL6862 DVB-Sx/Tx/C driver configuration
#

menu "AVL6862 DVB-Sx/Tx/C driver"

config AM_DVB
	tristate "AVL6862 DVB-Sx/Tx/C driver"
	default y
	select DVB_CORE
	help
	Select to enable AVL6862 DVB-Sx/Tx/C driver.

endmenu
```
